## base_external/package/aesd-assignments/Config.in
```kconfig
config BR2_PACKAGE_AESD_ASSIGNMENTS
	bool "aesd-assignments"
	help
	  Includes the writer executable, finder.sh and tester.sh in the kernel image.
	  Used to understand buildroot external trees and package builds.

config BR2_PACKAGE_BUSYBOX_BUILDROOT
	bool "busybox-buildroot"
	help
	  Buildroot external trees and package builds.
```

## base_external/package/buildroot/Config.in
```kconfig
config BR2_PACKAGE_BUILDROOT
	bool "buildroot"
	help
	  Buildroot external trees and package builds.
```
